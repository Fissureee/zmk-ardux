/*
 * Copyright (c) 2021 Dennis "depadiernos" Padiernos
 *
 * SPDX-License-Identifier: MIT
 */

#include <behaviors.dtsi>
#include <dt-bindings/zmk/keys.h>
#include <dt-bindings/zmk/bt.h>

// Left/Right
#define ARDUX_LEFT 1

// ARTS Row
#define KEY_A 3
#define KEY_R 2
#define KEY_T 1
#define KEY_S 0
// EYIO Row
#define KEY_E 7
#define KEY_Y 6
#define KEY_I 5
#define KEY_O 4

// Define Offsets
#define LEADING_NONES NONE(0,0,0)
#define MIDDLE_NONES NONE(0, 0, 0)
#define TRAILING_NONES NONE(0, 0, 0)

// Define Custom Layer
#define ARDUX_LAYER_CUSTOM                                              \
		custom {                                                        \
			display-name = "Custom";                                    \
			bindings = <                                                \
				LEADING_NONES                                           \
				&kp C_MUTE          &kp C_VOL_UP  &kp C_PP   &kp C_NEXT \
				MIDDLE_NONES                                            \
				&mo LAYER_ID_CUSTOM &kp C_VOL_DN  &kp PSCRN  &kp C_PREV \
				TRAILING_NONES                                          \
			>;                                                          \
		};

// Include main ardux.io keymap
#include "../../../ardux.dtsi"